## drivers/gpu/drm/amd/display/amdgpu_dm/tests/Kconfig
```kconfig
# SPDX-License-Identifier: MIT
menu "DML Unit Tests"
	depends on DRM_AMD_DC && KUNIT=m

config BW_FIXED_KUNIT_TEST
	bool "Enable unit tests for dml/calcs/bw_fixed" if !DML_KUNIT_TEST
	default y if DML_KUNIT_TEST
	help
		Enables unit tests for the dml/calcs/bw_fixed. Only useful for kernel
		devs running KUnit.

		For more information on KUnit and unit tests in general please refer to
		the KUnit documentation in Documentation/dev-tools/kunit/.

		If unsure, say N.

config DISPLAY_MODE_LIB_KUNIT_TEST
	bool "Enable unit tests for dml/display_mode_lib" if !DML_KUNIT_TEST
	default y if DML_KUNIT_TEST
	help
		Enables unit tests for the dml/display_mode_lib. Only useful for kernel
		devs running KUnit.

		For more information on KUnit and unit tests in general please refer to
		the KUnit documentation in Documentation/dev-tools/kunit/.

		If unsure, say N.

config DML_KUNIT_TEST
	bool "Run all unit tests for DML" if !KUNIT_ALL_TESTS
	default KUNIT_ALL_TESTS
	help
		Enables unit tests for the Display Mode Library. Only useful for kernel
		devs running KUnit.

		For more information on KUnit and unit tests in general please refer to
		the KUnit documentation in Documentation/dev-tools/kunit/.

		If unsure, say N.

endmenu
```

## drivers/gpu/drm/amd/display/dc/Kconfig
```kconfig
# SPDX-License-Identifier: MIT
menu "Display Core Unit Tests"
	depends on DRM_AMD_DC && KUNIT=y

config DC_KUNIT_TEST
	bool "Run all unit tests for Display Core" if !KUNIT_ALL_TESTS
	default KUNIT_ALL_TESTS
	help
		Enables unit tests for the Display Core. Only useful for kernel
		devs running KUnit.

		For more information on KUnit and unit tests in general please refer to
		the KUnit documentation in Documentation/dev-tools/kunit/.

		If unsure, say N.

config DC_BASICS_FIXPT31_32_KUNIT_TEST
	bool "Enable unit tests for dc/basics/fixpt31_32" if !DC_KUNIT_TEST
	default y if DC_KUNIT_TEST
	help
		Enables unit tests for the dc/basics/fixpt31_32. Only useful for kernel
		devs running KUnit.

		For more information on KUnit and unit tests in general please refer to
		the KUnit documentation in Documentation/dev-tools/kunit/.

		If unsure, say N.

endmenu
```
